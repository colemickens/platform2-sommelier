/*
 * Copyright 2016 The Chromium OS Authors. All rights reserved.
 *
 * Use of this source code is governed by a BSD-style license that can be
 * found in the LICENSE file.
 */

/dts-v1/;

/* This file has an incorrect structure (models should be within chromeos) */
/ {
	chromeos {
	};

	models: models {
	};
};

&models {
	pyro {
		wallpaper = "default";
		string-list = "default", "more";
	};
};
