/*
 * This is a generated file, DO NOT EDIT!'
 *
 * This provides a map from property name to target directory for all PropFile
 * objects defined in the schema.
 */

/ {
	chromeos {
		schema {
			phandle-properties = "arc-properties-type",
				"audio-type", "bcs-type", "power-type",
				"shares", "single-sku", "touch-type",
				"whitelabel";
			target-dirs {
				alsa-conf = "/usr/share/alsa/ucm";
				cras-config-dir = "/etc/cras";
				dptf-dv = "/etc/dptf";
				dsp-ini = "/etc/cras";
				hifi-conf = "/usr/share/alsa/ucm";
				topology-bin = "/lib/firmware";
				volume = "/etc/cras";
			};
		};
	};
};

